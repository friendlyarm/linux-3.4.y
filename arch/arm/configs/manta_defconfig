## drivers/media/video/nexell/m2m/Kconfig
```kconfig
if VIDEO_NXP_M2M

config NXP_M2M_SCALER
    bool "Enable scaler"
    default n
    ---help---
      Say y here to enable scaler

config ENABLE_SCALER_MISC_DEVICE
    bool "Enable scaler misc device"
    depends on NXP_M2M_SCALER
    default n
    ---help---
      Say y here to enable scaler misc device

config USE_SCALER_COMMAND_BUFFER
    bool "Use scaler command buffer engine"
    depends on NXP_M2M_SCALER
    default n
    ---help---
      Say y here to use command buffer engine

config NXP_M2M_DEINTERLACER
    bool "Enable deinterlacer"
    default n
    ---help---
      Say y here to enable deinterlacer

endif
```

## drivers/media/video/nexell/out/Kconfig
```kconfig
if VIDEO_NXP_OUT

config NXP_OUT_RESOLUTION_CONVERTER
    bool "Enable out resolution converter"
	select NXP_DISPLAY_RESCONV
    default n
    ---help---
      Say y here to enable v4l2 resolution converter

config NXP_OUT_HDMI
    bool "Enable out HDMI"
    default n
    ---help---
      Say y here to enable v4l2 hdmi

if NXP_OUT_HDMI
source arch/arm/mach-s5p4418/soc/hdmi/Kconfig
endif

config NXP_HDMI_CEC
    depends on NXP_OUT_HDMI || NXP_DISPLAY_HDMI
    bool "Enable HDMI CEC Misc Driver"
    default n
    ---help---
      Say y here to enable hdmi cec module

config NXP_OUT_TVOUT
    bool "Enable tvout"
    select NXP_DISPLAY_TVOUT
    depends on ARCH_S5P6818
    default n
    ---help---
      Say y here to enable v4l2 tvout

endif
```

## drivers/media/video/thine/Kconfig
```kconfig
config VIDEO_THP7212_CAM
    tristate "THine THP7212 sensor support(nexell work)"
    depends on I2C && VIDEO_V4L2
    ---help---
	  This is a Video4Linux2 sensor-level driver for the THine
	  THP7212 13M Pixel CMOS sensor.
```

## drivers/media/video/tw/Kconfig
```kconfig
config VIDEO_TW9992
    tristate "TW9992 video decoder"
    depends on I2C && VIDEO_V4L2
    ---help---
	  Support for the Intersil/Techwell TW9992 video decoder.

config VIDEO_TW9900
    tristate "TW9900 video decoder"
    depends on I2C && VIDEO_V4L2
    ---help---
      Support for the Intersil/Techwell TW9900 video decoder.
```
