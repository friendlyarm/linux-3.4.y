## arch/arm/mach-s5p6818/Kconfig
```kconfig
#
# Copyright 2009 Nexell.
#

config ARCH_CPU_SLSI
	bool
	select IRQ_DOMAIN
	select MULTI_IRQ_HANDLER
	default y

config ARCH_S5P6818_REV
	bool "s5p6818 revision"
	default y

choice
	prompt "Prototype build mode"
	default S5P6818_PROTO_RELEASE

config  S5P6818_PROTO_RELEASE
	bool "Release"

config  S5P6818_PROTO_DEBUG
	bool "Debug"
endchoice

choice
	prompt "Memory max order"
	default S5P6818_MEM_MAX_ORDER_11

config	S5P6818_MEM_MAX_ORDER_11
	bool "4Mbyte"

config	S5P6818_MEM_MAX_ORDER_12
    bool "8Mbyte"

config	S5P6818_MEM_MAX_ORDER_13
	bool "16Mbyte"

endchoice

config FORCE_MAX_ZONEORDER
   	int
   	default 11 if S5P6818_MEM_MAX_ORDER_11
   	default 12 if S5P6818_MEM_MAX_ORDER_12
   	default 13 if S5P6818_MEM_MAX_ORDER_13

comment "CPU feature"

config S5P6818_PM_IDLE
	bool "Goto idle when Suspend"
	depends on SUSPEND
	default n

config PM_DBGOUT
	bool "Support PM_DBGOUT"
	default n

config HAVE_PWM
	prompt "PWM driver"
	bool
	select NXP_SOC_PWM
	default y

config PWM_SYSFS
	bool "/sys/devices/platform/pwm.N (sysfs interface)"
	depends on HAVE_PWM
	default y

config HAVE_PWM_CH0
	bool "pwm 0"
	depends on HAVE_PWM
	default y

config HAVE_PWM_CH1
	bool "pwm 1"
	depends on HAVE_PWM
	default n

config HAVE_PWM_CH2
	bool "pwm 2"
	depends on HAVE_PWM
	default n

config HAVE_PWM_CH3
	bool "pwm 3"
	depends on HAVE_PWM
	default n

config NXP_SOC_PWM
	bool "Support PWM SoC"
	default y if HAVE_PWM

config NXP_DISPLAY
	bool "Support Display SoC"
	default n

config NXP_DISPLAY_1ST
	bool "Primary   display output (MLC0/DPC0)"
	depends on NXP_DISPLAY

config NXP_DISPLAY_2ST
	bool "Secondary display output (MLC1/DPC1)"
	depends on NXP_DISPLAY

config NXP_DISPLAY_RESCONV
	bool "Resolution Converter"
	depends on NXP_DISPLAY
	default n

config ANDROID_PERSISTENT_RAM_CONS_AREA
    hex "RAM console physical hex address"
    depends on ANDROID_RAM_CONSOLE
    default 0x0

config ANDROID_PERSISTENT_RAM_CONS_SIZE
    int "RAM console size (KB)"
    depends on ANDROID_RAM_CONSOLE
    default 16

source "arch/arm/plat-s5p6818/Kconfig"
```

## arch/arm/plat-s5p4418/Kconfig
```kconfig
#
# Copyright 2009 Nexell.
#

# Select Board types
comment "Board features"

choice
    prompt "Platform board"
    default PLAT_S5P4418_DRONE

	config PLAT_S5P4418_DRONE
		bool "DRONE: Android drone board"
		help
   	 		Support for the drone board.

	config PLAT_S5P4418_SVT
		bool "SVT: Linux svt board"
		help
   	 		Support for the svt board.

	config PLAT_S5P4418_ASB
		bool "ASB: Linux asb board"
		help
   	 		Support for the asb board.

	config PLAT_S5P4418_LEPUS
		bool "DRONE: Android lepus board"
		help
   	 		Support for the drone board.

endchoice

#
# Board dependent configure
#
```

## arch/arm/plat-s5p6818/Kconfig
```kconfig
#
# Copyright 2009 Nexell.
#


# Select Board types
comment "Board features"

choice
    prompt "Platform board"
    default PLAT_S5P6818_DRONE

	config PLAT_S5P6818_VTK
		bool "VTK: Validation Kit board"
		help
   	 		Support for the validation kit board.

	config PLAT_S5P6818_DRONE
		bool "DRONE: Android drone board"
		help
   	 		Support for the drone board.

   	config PLAT_S5P6818_FDONE
		bool "FDONE: Android FDONE board"
		help
   	 		Support for the FDONE board.

   	config PLAT_S5P6818_SVT
		bool "SVT: Android SVT board"
		help
   	 		Support for the SVT board.

   	config PLAT_S5P6818_ASB
		bool "ASB: Android ASB board"
		help
   	 		Support for the ASB board.


endchoice

#
# Board dependent configure
#
```

## drivers/block/nand_ftl/Kconfig
```kconfig
#
# FTL device driver configuration
#

menuconfig NXP_FTL
	bool "NXP NAND FTL"
	select NAND_FTL
	depends on BLOCK
	default n
	---help---

if NXP_FTL

config NAND_FTL
	depends on BLOCK
	depends on ARCH_NXP4330 || ARCH_S5P4418 || ARCH_S5P6818
	default y
	bool "NXP Nand FTL Driver"

endif # NXP_FTL
```

## drivers/block/nand_ftl/mio/Kconfig
```kconfig
#
# FTL device driver configuration
#

menuconfig NEXELL_FTL
	bool "Nexell NAND FTL"
	depends on BLOCK
	default n
	---help---

if NEXELL_FTL

config NAND_FTL
	depends on BLOCK
	depends on ARCH_NXP4330 || ARCH_S5P4418 || ARCH_S5P6818
	tristate "NEXELL Nand FTL Driver"

endif # NEXELL_FTL
```

## drivers/gpu/arm/vr/Kconfig
```kconfig
config VR400
	tristate "Vr-300/400/450 support"
	depends on ARM
	select DMA_SHARED_BUFFER
	---help---
	  This enables support for the ARM Vr-300, Vr-400, and Vr-450
	  GPUs.

	  To compile this driver as a module, choose M here: the module will be
	  called vr.

config VR450
	bool "Enable Vr-450 support"
	depends on VR400
	---help---
	  This enables support for Vr-450 specific features.

config VR400_DEBUG
	bool "Enable debug in Vr driver"
	depends on VR400
	---help---
	  This enabled extra debug checks and messages in the Vr driver.

config VR400_PROFILING
	bool "Enable Vr profiling"
	depends on VR400
	select TRACEPOINTS
	default y
	---help---
	  This enables gator profiling of Vr GPU events.

config VR400_INTERNAL_PROFILING
	bool "Enable internal Vr profiling API"
	depends on VR400_PROFILING
	default n
	---help---
	  This enables the internal legacy Vr profiling API.

config VR400_UMP
	bool "Enable UMP support"
	depends on VR400
	---help---
	  This enables support for the UMP memory sharing API in the Vr driver.

config VR400_POWER_PERFORMANCE_POLICY
	bool "Enable Vr power performance policy"
	depends on ARM
	default n
	---help---
	  This enables support for dynamic performance scaling of Vr with the goal of lowering power consumption.

config VR_DMA_BUF_MAP_ON_ATTACH
	bool "Map dma-buf attachments on attach"
	depends on VR400 && DMA_SHARED_BUFFER
	default y
	---help---
	  This makes the Vr driver map dma-buf attachments after doing
	  attach. If this is not set the dma-buf attachments will be mapped for
	  every time the GPU need to access the buffer.

	  Mapping for each access can cause lower performance.

config VR_SHARED_INTERRUPTS
	bool "Support for shared interrupts"
	depends on VR400
	default n
	---help---
	  Adds functionality required to properly support shared interrupts.  Without this support,
	  the device driver will fail during insmod if it detects shared interrupts.  This also
	  works when the GPU is not using shared interrupts, but might have a slight performance
	  impact.

config VR_PMU_PARALLEL_POWER_UP
	bool "Power up Vr PMU domains in parallel"
	depends on VR400
	default n
	---help---
	  This makes the Vr driver power up all PMU power domains in parallel, instead of
	  powering up domains one by one, with a slight delay in between. Powering on all power
	  domains at the same time may cause peak currents higher than what some systems can handle.
	  These systems must not enable this option.
```

## drivers/gpu/ion/Kconfig
```kconfig
menuconfig ION
	tristate "Ion Memory Manager"
	select GENERIC_ALLOCATOR
	select DMA_SHARED_BUFFER
	help
	  Chose this option to enable the ION Memory Manager.

config ION_TEGRA
	tristate "Ion for Tegra"
	depends on ARCH_TEGRA && ION
	help
	  Choose this option if you wish to use ion on an nVidia Tegra.

config ION_NXP
	tristate "Ion for SLsiAP"
	depends on ARCH_CPU_SLSI && ION
    select CMA
	help
	  Choose this option if you wish to use ion on an Nexell Nxp.

config ION_NXP_CONTIGHEAP_SIZE
    int "Size in Kilobytes of memory pool of SLSI_CONTIG_HEAP"
    depends on ION_NXP && CMA
    default 40960

config ION_NXP_RESERVE
	tristate "Ion reserve region for bootloader share memory"
	depends on ARCH_CPU_SLSI && ION_NXP
	help
	  Choose this option if you wish to use ion reserve on an Nexell Nxp.

config ION_NXP_RESERVEHEAP_SIZE
    int "Size in Kilobytes of memory pool of NXP_RESERVE_HEAP"
    depends on ION_NXP_RESERVE
    default 2700

config ION_EXYNOS
	tristate "Ion for Exynos"
	depends on ARCH_EXYNOS && ION
	select CMA
	help
	  Choose this option if you wish to use ion on a Samsung Exynos.

config ION_EXYNOS_CONTIGHEAP_SIZE
	int "Size in Kilobytes of memory pool of EXYNOS_CONTIG_HEAP"
	depends on ION_EXYNOS && CMA
	default 45056

config ION_EXYNOS_DRM_MFC_SH
	bool "ION Heap for drm mfc sh"
	depends on EXYNOS_CONTENT_PATH_PROTECTION
	default y

config ION_EXYNOS_DRM_MSGBOX_SH
	bool "ION Heap for drm msgbox sh"
	depends on EXYNOS_CONTENT_PATH_PROTECTION
	default y

config ION_EXYNOS_DRM_MFC_FW
	bool "ION Heap for drm fw"
	depends on EXYNOS_CONTENT_PATH_PROTECTION
	default y

config ION_EXYNOS_DRM_SECTBL
	bool "ION Heap for drm sectbl"
	depends on EXYNOS_CONTENT_PATH_PROTECTION
	default y

config ION_EXYNOS_DRM_MEMSIZE_FIMD_VIDEO
	int "Reserved memsize in kilobytes for FIMD VIDEO"
	depends on EXYNOS_CONTENT_PATH_PROTECTION
	default 184320

config ION_EXYNOS_DRM_MEMSIZE_MFC_OUTPUT
	int "Reserved memsize in kilobytes for MFC OUTPUT"
	depends on EXYNOS_CONTENT_PATH_PROTECTION
	default 51200

config ION_EXYNOS_DRM_MEMSIZE_MFC_INPUT
	int "Reserved memsize in kilobytes for MFC INPUT"
	depends on EXYNOS_CONTENT_PATH_PROTECTION
	default 16384
```

## drivers/hwmon/bosch/Kconfig
```kconfig
config BOSCH
	tristate "Bosch Sensor Driver"
	depends on I2C && EXPERIMENTAL
	default n
	help
	  Say yes here if you want to enable Bosch support.

config SENSORS_BMA2X2
	tristate "BMA255/BMA250E/BMA222E/BMA280 acceleration sensor support"
	depends on I2C=y && BOSCH
	help
	  If you say yes here you get support for Bosch Sensortec's 
	  acceleration sensors BMA255/BMA250E/BMA222E/BMA280.

config SENSORS_BMM050
	tristate "BMM050 Magnetic Sensor Driver"
	depends on I2C=y && BOSCH
	help
	 BMM050 Magnetic Sensor Driver implemented by Bosch-Sensortec.

config SENSORS_BMG
	tristate "Bosch Gyroscope Sensor Driver"
	depends on I2C && BOSCH
	help
     If you say yes here you get support for Bosch Sensortec's
     gyroscope sensor drivers of BMG160/BMI055/etc.

config SENSORS_BMG_FIFO    
	tristate "Bosch Gyroscope FIFO Support"
	depends on SENSORS_BMG     
	help              
       Bosch Gyroscope Driver support FIFO operations.
```

## drivers/media/dvb/dvb-soc/Kconfig
```kconfig
config NXP_MP2TS_IF
	tristate "NXP MP2TS driver"
	depends on I2C
	help
	  Support for MP2TS I/F based on the NXP.
```

## drivers/media/dvb/siano/Kconfig
```kconfig
#
# Siano Mobile Silicon Digital TV device configuration
#

config SMS_SIANO_MDTV
	tristate "Siano SMSxxxx based MDTV receiver"
	---help---
	  Choose Y or M here if you have MDTV receiver with a Siano chipset.

	  To compile this driver as a module, choose M here
	  (The module will be called smsmdtv).

	  Further documentation on this driver can be found on the WWW
	  at http://www.siano-ms.com/

menu "Siano module components"

# Kernel sub systems support

config SMS_RC_SUPPORT_SUBSYS
	bool "Remote Control Subsystem support"
	depends on RC_CORE
	default n
	---help---
	Choose if you would like to have Siano's ir remote control sub-system support.

config SMS_HOSTLIB_SUBSYS
	bool "Host Library Subsystem support"
	default n
	---help---
	Choose if you would like to have Siano's host library kernel sub-system support.

config SMS_DVB_API_SUBSYS
	bool "DVB API Subsystem support"
	depends on DVB_CORE
	default n
	---help---
	Choose if you would like to have Siano's host library kernel sub-system support.

if SMS_HOSTLIB_SUBSYS
config SMS_NET_SUBSYS
	bool "Siano Network Adapter"
	depends on NET
	default n
	---help---
	Choose if you would like to have Siano's network adapter support.
endif # SMS_HOSTLIB_SUBSYS

# Hardware interfaces support

config SMS_USB_DRV
	bool "USB interface support"
	depends on USB
	default y if USB
	---help---
	  Choose if you would like to have Siano's support for USB interface

config SMS_SDIO_DRV
	bool "SDIO interface support"
	depends on MMC
	---help---
	  Choose if you would like to have Siano's support for SDIO interface

config SMS_SPI_DRV
	bool "SPI interface support"
	depends on SPI
	default y if SPI
	---help---
	Choose if you would like to have Siano's support for PXA 310 SPI interface

config SMS_I2C_DRV
	bool "I2C interface support"
	depends on I2C
	---help---
	Choose if you would like to have Siano's support for I2C interface

endmenu
```

## drivers/media/video/coda960/Kconfig
```kconfig
config NXP_VPU
    bool "Enable coda960 IP"
    default n
    ---help---
      Say y here to enable CODA960 ip
```

## drivers/media/video/exynos/Kconfig
```kconfig
#
# Exynos multimedia device drivers
#
config VIDEO_EXYNOS
	bool "Exynos Multimedia Devices"
	depends on ARCH_EXYNOS5
	default n
	select VIDEO_FIXED_MINOR_RANGES
	help
	  This is a representative exynos multimedia device.

if VIDEO_EXYNOS
	source "drivers/media/video/exynos/mdev/Kconfig"
	source "drivers/media/video/exynos/fimc-lite/Kconfig"
	source "drivers/media/video/exynos/mipi-csis/Kconfig"
	source "drivers/media/video/exynos/gsc/Kconfig"
	source "drivers/media/video/exynos/jpeg/Kconfig"
	source "drivers/media/video/exynos/fimg2d/Kconfig"
	source "drivers/media/video/exynos/mfc/Kconfig"
	source "drivers/media/video/exynos/tv/Kconfig"
	source "drivers/media/video/exynos/rotator/Kconfig"
endif

choice
depends on VIDEO_EXYNOS
prompt "FIMC_IS(Image Signal Process) version"
default VIDEO_EXYNOS5_FIMC_IS
config VIDEO_EXYNOS5_FIMC_IS
	bool "Camera 1.0"
	help
		This will be use fimc_is_mc for camera 1.0

config VIDEO_EXYNOS5_FIMC_IS2
	bool "Camera 2.0"
	help
		This will be use fimc_is_mc2 for camera 2.0
endchoice

config MEDIA_EXYNOS
	bool
	help
	  Compile mdev to use exynos5 media device driver.
```

## drivers/media/video/exynos/fimg2d/Kconfig
```kconfig
# drivers/media/video/exynos/fimg2d/Kconfig
#
# Copyright (c) 2011 Samsung Electronics Co., Ltd.
#	http://www.samsung.com/
#
# Licensed under GPLv2

config VIDEO_EXYNOS_FIMG2D
	bool "Samsung Graphics 2D Driver"
	depends on VIDEO_EXYNOS && (ARCH_EXYNOS4 || ARCH_EXYNOS5)
	default n
	---help---
	  This is a graphics 2D driver for Samsung ARM based SoC.

config VIDEO_FIMG2D_DEBUG
	bool "Enables FIMG2D debug messages"
	depends on VIDEO_EXYNOS_FIMG2D
	default n
	---help---
	  This enables FIMG2D driver debug messages.
```

## drivers/media/video/exynos/mfc/Kconfig
```kconfig
config EXYNOS_MFC_V6
	bool

config VIDEO_EXYNOS_MFC
	bool "Exynos MFC 6.x Driver"
	depends on VIDEO_EXYNOS
	select VIDEOBUF2_CORE
	select EXYNOS_MFC_V6
	---help---
	  MFC driver for V4L2.
```

## drivers/media/video/nexell/Kconfig
```kconfig
#
# Nexell multimedia device drivers
#
menuconfig V4L2_NXP
    bool "Nexell V4L2 Devices"
    depends on ARCH_CPU_SLSI
    select V4L2_MEM2MEM_DEV
    default n
    ---help---
      This is a representative nexell v4l2 device.

if V4L2_NXP

menuconfig VIDEO_NXP_CAPTURE
    bool "Nexell Video capture interface"
    depends on V4L2_NXP
    default n
    ---help---
      Say Y here to enable Nexell Video Capture Interface

if VIDEO_NXP_CAPTURE
source "drivers/media/video/nexell/capture/Kconfig"
endif

menuconfig VIDEO_NXP_M2M
    bool "Nexell M2M interface"
    depends on V4L2_NXP
    default n
    ---help---
      Say y here to enable Nexell M2M scaler or deinterlacer

if VIDEO_NXP_M2M
source "drivers/media/video/nexell/m2m/Kconfig"
endif

menuconfig VIDEO_NXP_OUT
    bool "Nexell OUT interface"
    depends on V4L2_NXP
    default n
    ---help---
      Say y here to enable mlc, resolution converter, hdmi

if VIDEO_NXP_OUT
source "drivers/media/video/nexell/out/Kconfig"
endif

endif
```

## drivers/media/video/nexell/capture/Kconfig
```kconfig
if VIDEO_NXP_CAPTURE

config NXP_CAPTURE_DECIMATOR
    bool "Enable capture decimator"
    default n
    ---help---
      Say y here to enable decimator

config NXP_CAPTURE_MIPI_CSI
    bool "Enable capture mipi csi interface"
    default n
    ---help---
      Say y here to enable capture mipi csi interface

config TURNAROUND_VIP_RESET
    bool "Apply turnaround vip reset"
    default n
    ---help---
      Say y here to apply turnaround vip reset code

config LOOPBACK_SENSOR_DRIVER
    bool "Loopback Capture Sensor Driver for Testing"
    default n
    ---help---
      Say y here to add loopback test sensor

endif
```
