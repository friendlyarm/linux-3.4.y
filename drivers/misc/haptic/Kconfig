## drivers/misc/haptic/Kconfig
```kconfig
config HAPTIC_DRV260X
	tristate "Haptic Controller(Immersion Corporation)"
	depends on I2C
	default n
	help
	  If you say yes here you get support for the Immersion Corporation DRV2604/DRV2605 haptic controller.

config HAPTIC_DRV2605
	tristate "DRV2604 Haptic Controller(Immersion Corporation)"
	depends on I2C && HAPTIC_DRV260X
	default n
	help
	  If you say yes here you get support for the Immersion Corporation DRV2604 haptic controller.
	  DRV2604 is a haptic motor driver with register based architecture, allowing for I2C control.
	  This driver provides haptic motor control and is accessed as a timed output device.

config HAPTIC_DRV2605
	tristate "DRV2605 Haptic Controller(Immersion Corporation)"
	depends on I2C && HAPTIC_DRV260X
	default n
	help
	  If you say yes here you get support for the Immersion Corporation DRV2605 haptic controller.
	  DRV2605 is a haptic motor driver with register based architecture, allowing for I2C control.
	  This driver provides haptic motor control and is accessed as a timed output device.
```

## drivers/net/ethernet/nexell/nxpmac/Kconfig
```kconfig
config NXPMAC_ETH
	tristate "Nexell 10/100/1000 Ethernet driver"
	depends on HAS_IOMEM && HAS_DMA
	select MII
	select PHYLIB
	select CRC32
	select PTP_1588_CLOCK
	---help---
	  This is the driver for the Ethernet IPs are built around a
	  Synopsys IP Core and only tested on the Nexell platforms.

if NXPMAC_ETH

config NXPMAC_PLATFORM
	bool "NXPMAC Platform bus support"
	depends on NXPMAC_ETH
	default y
	---help---
	  This selects the platform specific bus support for
	  the nxpmac device driver. This is the driver used
	  on many embedded STM platforms based on ARM and SuperH
	  processors.
	  If you have a controller with this interface, say Y or M here.

	  If unsure, say N.

config NXPMAC_PCI
	bool "NXPMAC PCI bus support"
	depends on NXPMAC_ETH && PCI
	---help---
	  This is to select the Synopsys DWMAC available on PCI devices,
	  if you have a controller with this interface, say Y or M here.

	  This PCI support is tested on XLINX XC2V3000 FF1152AMT0221
	  D1215994A VIRTEX FPGA board.

	  If unsure, say N.

config NXPMAC_DEBUG_FS
	bool "Enable monitoring via sysFS "
	default n
	depends on NXPMAC_ETH && DEBUG_FS
	---help---
	  The nxpmac entry in /sys reports DMA TX/RX rings
	  or (if supported) the HW cap register.

config NXPMAC_DA
	bool "NXPMAC DMA arbitration scheme"
	default n
	---help---
	  Selecting this option, rx has priority over Tx (only for Giga
	  Ethernet device).
	  By default, the DMA arbitration scheme is based on Round-robin
	  (rx:tx priority is 1:1).

endif
```

## drivers/power/axp_power/Kconfig
```kconfig
menuconfig KP_AXP
	bool "AXP Power drivers"
	depends on REGULATOR
	default n
	---help---
	  This option allows you to select AXP power driver

if KP_AXP

choice
	prompt "AXP PMU type"
	default KP_AXP22

config KP_AXP22
	bool "AXP22 driver"
	---help---
	  AXP22 driver

endchoice

config AXP_REGULATOR
	bool "AXP Regulator Driver"
	default n

config AXP_BATTERY
	bool "AXP Battery Driver"
	default n

config AXP_DEBUG
	bool "AXP debug interface"
	default n
	
config KP_OUTPUTINIT
	bool "AXP output init"
	default n
	
config AXP_CHARGEINIT
	bool "AXP initial charging environment set"
	default y

config AXP_CHGCHANGE
	bool "AXP charging current set when suspend\resume\shutdown"
	default y

config AXP_GPIO
	bool "AXP gpio driver"
	default n

endif # !KP_AXP
```

## drivers/staging/iio/pressure/Kconfig
```kconfig
#
# Pressure sensors
#
menu "Pressure sensors"

config BMP182
	tristate "BMP182 digital pressure sensor"
	depends on I2C
	default n
	help
	  If you say yes here you get support for the Bosch Sensortec
	  BMP182 digital pressure sensor.

	  To compile this driver as a module, choose M here: the
	  module will be called bmp182.

endmenu
```

## drivers/video/nexell/Kconfig
```kconfig
#
# Video configuration
#

menu "Nexell Graphics"
	depends on HAS_IOMEM

config FB_NXP_ION_MEM
	bool "Allocate framebuffer with ION "
	depends on FB_NXP
	select ION
	select ION_NXP
	default n

config FB0_NXP
	bool "Support primary   frame buffer (/dev/fb0)"
	depends on FB_NXP
	default y

	config FB0_NXP_DISPOUT
		int "Display Out [0/1]"
		depends on FB0_NXP
		default 0

	config FB0_NXP_FIXED_DPI
		bool "Size (mm) in Fixed DPI"
		depends on FB0_NXP
		default n

config FB1_NXP
	bool "Support secondary frame buffer (/dev/fb1)"
	depends on FB_NXP
	default n

	config FB1_NXP_DISPOUT
		int "Display Out [0/1]"
		depends on FB1_NXP
		default 1

config NXP_DISPLAY_LCD
	bool "LCD"
	default n

	config NXP_DISPLAY_LCD_IN
		int "Display In  [0=Display 0, 1=Display 1]"
		depends on NXP_DISPLAY_LCD
		default 0

config NXP_DISPLAY_LVDS
	bool "LVDS"
	default n

	config NXP_DISPLAY_LVDS_IN
		int "Display In  [0=Display 0, 1=Display 1]"
		depends on NXP_DISPLAY_LVDS
		default 0

config NXP_DISPLAY_MIPI
	bool "MIPI"

	config NXP_DISPLAY_MIPI_IN
		int "Display In  [0=Display 0, 1=Display 1]"
		depends on NXP_DISPLAY_MIPI
		default 0

config NXP_DISPLAY_TVOUT
	bool "TVOUT"
	default n

config NXP_DISPLAY_HDMI
	bool "HDMI"

	config NXP_DISPLAY_HDMI_IN
		int "Display In  [0=Display 0, 1=Display 1]"
		depends on NXP_DISPLAY_HDMI
		default 0

	choice
		prompt "Resolution"
		depends on NXP_DISPLAY_HDMI
		default NXP_DISPLAY_HDMI_1280_720P

	config	NXP_DISPLAY_HDMI_1280_720P
		bool "1280 *  720p"

	config	NXP_DISPLAY_HDMI_1920_1080P
		bool "1920 * 1080p"

	endchoice

    choice
        prompt "HDMI Audio Interface"
        depends on NXP_OUT_HDMI || NXP_DISPLAY_HDMI
        default NXP_DISPLAY_HDMI_AUDIO_SPDIF
        help
          Choose which interface to use for hdmi audio output

    config NXP_DISPLAY_HDMI_AUDIO_SPDIF
        bool "SPDIF"

    config NXP_DISPLAY_HDMI_AUDIO_I2S
        bool "I2S"

    endchoice

config NXP_DISPLAY_HDMI_USE_HDCP
    depends on NXP_DISPLAY_HDMI
    bool "HDMI use HDCP block"
    default n
    ---help---
      Say y here to enable hdcp module

endmenu
```

## drivers/video/nexell/Kconfig.resc
```kconfig
#
# Video configuration
#

menu "Graphics support"
	depends on HAS_IOMEM

config FB_NXP_ION_MEM
	bool "Allocate framebuffer with ION "
	depends on FB_NXP
	select ION
	select ION_NXP
	default n

config FB0_NXP
	bool "Support primary   frame buffer (/dev/fb0)"
	depends on FB_NXP
	select NXP_DISPLAY
	select NXP_DISPLAY_1ST
	default y

	config FB0_NXP_DISPOUT
		int "Display Out [0/1]"
		depends on FB0_NXP
		default 0

config FB1_NXP
	bool "Support secondary frame buffer (/dev/fb1)"
	depends on FB_NXP
	select NXP_DISPLAY
	select NXP_DISPLAY_2ST
	default n

	config FB1_NXP_DISPOUT
		int "Display Out [0/1]"
		depends on FB1_NXP
		default 1

config NXP_DISPLAY_LCD
	bool "LCD"
	default n

	config NXP_DISPLAY_LCD_IN
		int "Display In  [0=Display 0, 1=Display 1, 2=Resolution Convertor]"
		depends on NXP_DISPLAY_LCD
		default 0

config NXP_DISPLAY_LVDS
	bool "LVDS"
	default n

	config NXP_DISPLAY_LVDS_IN
		int "Display In  [0=Display 0, 1=Display 1, 2=Resolution Convertor]"
		depends on NXP_DISPLAY_LVDS
		default 0

config NXP_DISPLAY_MIPI
	bool "MIPI"

	config NXP_DISPLAY_MIPI_IN
		int "Display In  [0=Display 0, 1=Display 1, 2=Resolution Convertor]"
		depends on NXP_DISPLAY_MIPI
		default 0

config NXP_DISPLAY_HDMI
	bool "HDMI"

	config NXP_DISPLAY_HDMI_IN
		int "Display In  [0=Display 0, 1=Display 1, 2=Resolution Convertor]"
		depends on NXP_DISPLAY_HDMI
		default 0

	choice
		prompt "Resolution"
		depends on NXP_DISPLAY_HDMI
		default NXP_DISPLAY_HDMI_1280_720P

	config	NXP_DISPLAY_HDMI_1280_720P
		bool "1280 *  720p"

	config	NXP_DISPLAY_HDMI_1920_1080P
		bool "1920 * 1080p"

	endchoice

config NXP_DISPLAY_RESC
	bool "RESOLUTION CONVERTOR"
	default n

	config NXP_DISPLAY_RESC_IN
		int "Display In  [0=Display 0, 1=Display 1]"
		depends on NXP_DISPLAY_RESC
		default 0

endmenu
```

## sound/soc/nexell/Kconfig
```kconfig
#
# Copyright 2010 Nexell.
#
# Configuration options for the S5Pxxx Sound

config SND_NXP_SOC
	tristate "S5Pxxx SoC Audio"
	depends on ARCH_CPU_SLSI
	select AMBA_PL08X
	help
	  Say Y or M if you want to add support for codecs attached to
	  the AC97 and I2S interface.

config SND_NXP_DFS
	bool "DFS featrue for I2S(default PLL2)"
	depends on SND_NXP_SOC
	help
	  Say Y if you want to add DFS feature support for I2S and interface.

choice
    prompt "Select SND PLL device"
    depends on SND_NXP_DFS
    default SND_NXP_PLL_2

config SND_NXP_PLL_2
    bool "PLL 2"

config SND_NXP_PLL_3
    bool "PLL 3"

endchoice

config SND_NXP_PLLDEV
    int 
    default 2 if SND_NXP_PLL_2
    default 3 if SND_NXP_PLL_3
										
config SND_NXP_I2S
	tristate

config SND_NXP_I2S_CH0
	bool "I2S 0"
	depends on SND_NXP_SOC
	select SND_NXP_I2S
	default y

config SND_NXP_I2S_CH1
	bool "I2S 1"
	depends on SND_NXP_SOC
	select SND_NXP_I2S
	default n

config SND_NXP_I2S_CH2
	bool "I2S 2"
	depends on SND_NXP_SOC
	select SND_NXP_I2S
	default n

config SND_NXP_SPDIF_TX
	tristate

config SND_NXP_SPDIF_RX
	tristate

config SND_SPDIF_TRANSCIEVER
	tristate "SPDIF transciever (PCM)"
	depends on SND_NXP_SOC
	select SND_NXP_SPDIF_TX
	select SND_SOC_SPDIF

config SND_SPDIF_RECEIVER
	tristate "SPDIF receiver (PCM)"
	depends on SND_NXP_SOC
	select SND_NXP_SPDIF_RX
	select SND_SOC_SPDIF

config SND_NXP_PDM
	tristate

config SND_PDM_REC
	tristate "PDM record (PCM)"
	depends on SND_NXP_SOC
	select SND_NXP_PDM
	default n

config SND_CODEC_NULL
	tristate "I2S audio null codec."
	depends on SND_NXP_I2S

config SND_CODEC_RT5631
	tristate "rt5631 I2S audio codec."
	depends on SND_NXP_I2S
	select SND_SOC_RT5631

config SND_CODEC_ES8316
	tristate "es8316 I2S audio codec."
	depends on SND_NXP_I2S
	select SND_SOC_ES8316

config SND_CODEC_ALC5623
	tristate "ALC562(123) I2S audio codec."
	depends on SND_NXP_I2S
	select SND_SOC_ALC5623

config SND_CODEC_ALC5633
        tristate "alc5633 I2S audio codec."
        depends on SND_NXP_I2S
        select SND_SOC_ALC5633

config SND_CODEC_WM8976
	tristate "wm8976 (wm8978) I2S audio codec."
	depends on SND_NXP_I2S
	select SND_SOC_WM8978

config SND_CODEC_CS42L51_NX
	tristate "cs42l51 I2S audio codec(S5Pxxx work)."
	depends on SND_NXP_I2S
	select SND_SOC_CS42L51_NX

config SND_CODEC_WM8903
	tristate "wm8903  I2S audio codec."
	depends on SND_NXP_I2S
	select SND_SOC_WM8903
```

## sound/soc/samsung/srp_alp/Kconfig
```kconfig
config SND_SAMSUNG_ALP
	depends on SND_SAMSUNG_I2S && ARCH_EXYNOS5
	bool "Low power audio support with SRP"
	default n
	help
	  Say Y if you want to support ALP audio.

config AUDIO_SAMSUNG_MEMSIZE_SRP
	int "Memory size in kbytes for ALP Audio"
	depends on SND_SAMSUNG_ALP
	default "1024"

config SND_SAMSUNG_RP_DEBUG
	bool "Enable debug message for ALP Audio"
	depends on SND_SAMSUNG_ALP
	default n
	help
	  Say Y if you want to add debug message for ALP Audio.
```
